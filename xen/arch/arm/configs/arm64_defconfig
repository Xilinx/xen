## xen/arch/arm/configs/arm64_defconfig
```kconfig
CONFIG_OVERLAY_DTB=y
CONFIG_HWDOM_LINUX_CMA=y
CONFIG_STATIC_MEMORY=y
CONFIG_IOREQ_SERVER=y
# CONFIG_XSM is not set
CONFIG_ARGO=y
# CONFIG_TRACEBUFFER is not set
CONFIG_LLC_COLORING=y
# CONFIG_HAS_NS16550 is not set
# CONFIG_HAS_MVEBU is not set
# CONFIG_HAS_MESON is not set
# CONFIG_HAS_SCIF is not set
CONFIG_ARM_SMMU_V3=y
CONFIG_EXPERT=y
# CONFIG_DEBUG_LOCKS is not set
# CONFIG_SCRUB_DEBUG is not set
# CONFIG_XMEM_POOL_POISON is not set
```

## xen/arch/x86/Kconfig.cpu
```kconfig
menu "Supported CPU vendors"
	visible if EXPERT

config AMD
	bool "Support AMD CPUs"
	default y
	help
	  Detection, tunings and quirks for AMD platforms.

	  May be turned off in builds targetting other vendors.  Otherwise,
	  must be enabled for Xen to work suitably on AMD platforms.

config INTEL
	bool "Support Intel CPUs"
	select CPUFREQ
	default y
	help
	  Detection, tunings and quirks for Intel platforms.

	  May be turned off in builds targetting other vendors.  Otherwise,
	  must be enabled for Xen to work suitably on Intel platforms.

config HYGON
	bool "Support Hygon CPUs"
	select AMD
	default y
	help
	  Detection, tunings and quirks for Hygon platforms.

	  May be turned off in builds targetting other vendors.  Otherwise,
	  must be enabled for Xen to work suitably on Hygon platforms.

config CENTAUR
	bool "Support Centaur CPUs"
	select INTEL
	default y
	help
	  Detection, tunings and quirks for Centaur platforms.

	  May be turned off in builds targetting other vendors.  Otherwise,
	  must be enabled for Xen to work suitably on Centaur platforms.

config SHANGHAI
	bool "Support Shanghai CPUs"
	select INTEL
	default y
	help
	  Detection, tunings and quirks for Shanghai platforms.

	  May be turned off in builds targetting other vendors.  Otherwise,
	  must be enabled for Xen to work suitably on Shanghai platforms.

config UNKNOWN_CPU_VENDOR
	bool "Support unknown CPU vendors"
	default y
	help
	  This option prevents a panic on boot when the host CPU vendor isn't
	  supported by going into a legacy compatibility mode and not applying
	  any relevant tunings or quirks.

	  Not selecting this option while selecting multiple vendors doesn't have
	  any major effect on code size, but selecting a single vendor with this
	  option cleared produces a much smaller build.

endmenu
```

## xen/arch/x86/hvm/Kconfig
```kconfig
menuconfig HVM
	bool "HVM support"
	depends on !PV_SHIM_EXCLUSIVE
	default !PV_SHIM
	select COMPAT
	select IOREQ_SERVER
	select MEM_ACCESS_ALWAYS_ON
	help
	  Interfaces to support HVM domains.  HVM domains require hardware
	  virtualisation extensions (e.g. Intel VT-x, AMD SVM), but can boot
	  guests which have no specific Xen knowledge.

	  This option is needed if you want to run HVM or PVH domains.

	  If unsure, say Y.

if HVM

config AMD_SVM
	bool "AMD-V" if EXPERT
	default AMD
	help
	  Enables virtual machine extensions on platforms that implement the
	  AMD Virtualization Technology (AMD-V).
	  If your system includes a processor with AMD-V support, say Y.
	  If in doubt, say Y.

config INTEL_VMX
	bool "Intel VT-x" if EXPERT
	default INTEL
	select ARCH_VCPU_IOREQ_COMPLETION
	help
	  Enables virtual machine extensions on platforms that implement the
	  Intel Virtualization Technology (Intel VT-x).
	  If your system includes a processor with Intel VT-x support, say Y.
	  If in doubt, say Y.

config HVM_FEP
	bool "HVM Forced Emulation Prefix support (UNSUPPORTED)" if UNSUPPORTED
	default DEBUG
	help
	  Compiles in a feature that allows HVM guest to arbitrarily
	  exercise the instruction emulator.

	  This feature can only be enabled during boot time with
	  appropriate hypervisor command line option. Please read
	  hypervisor command line documentation before trying to use
	  this feature.

	  This is strictly for testing purposes, and not appropriate
	  for use in production.

	  If unsure, say N.

config ALTP2M
	bool "Alternate P2M support" if EXPERT
	depends on INTEL_VMX
	default y
	help
	  Alternate-p2m allows a guest to manage multiple p2m guest physical
	  "memory views" (as opposed to a single p2m).
	  Useful for memory introspection.

	  If unsure, stay with defaults.

config VIRIDIAN
	bool "Hyper-V enlightenments for guests" if EXPERT
	depends on AMD_SVM || INTEL_VMX
	default y
	help
	  Support optimizations for Hyper-V guests such as faster hypercalls,
	  efficient timer and interrupt handling, and enhanced paravirtualized
	  I/O. This is to improve performance and compatibility of Windows VMs.

	  If unsure, say Y.

config MEM_PAGING
	bool "Xen memory paging support (UNSUPPORTED)" if UNSUPPORTED
	depends on VM_EVENT

config MEM_SHARING
	bool "Xen memory sharing support (UNSUPPORTED)" if UNSUPPORTED

config VPIC
	bool "Virtual PIC (8259A) support"
	default y
	help
	  Enable virtual PIC (8259A Programmable Interrupt Controller) emulation
	  for x86 guests. This provides legacy interrupt controller functionality
	  required by older operating systems and for compatibility.

	  This feature is available for all domain types (PV, PVH, and HVM).
	  For PV domains, it provides basic PIC state structure. For PVH and HVM
	  domains, it provides full PIC functionality including interrupt routing
	  and port I/O handlers.

	  Modern guests that use only APIC for interrupt handling can opt out of
	  this feature to reduce attack surface and improve performance.

	  If unsure, say Y.

config VVGA
    bool "Virtual Standard VGA support"
    default y
    help
      Enable virtual Standard VGA emulation.
      This improves the performance of Standard VGA, the mode used during
      Windows boot and by the Linux splash screen.

      If unsure, say Y.

config VRTC
    bool "Virtual RTC (MC146818) support"
    default y
    help
      Enable virtual RTC/CMOS (MC146818) emulation.
      This feature is available for HVM and PVH domains.

      If unsure, say Y.

config VHPET
    bool "Virtual HPET (High Precision Event Timers) support"
    default y
    help
      Enable virtual HPET (High Precision Event Timers) emulation.
      This feature is available for HVM and PVH domains.

      If unsure, say Y.

endif
```

## xen/common/Kconfig.decompress
```kconfig
menu "Guest Kernel image de-compressors"
    depends on X86

config DECOMP_BUNZIP2
    bool "bzip2 decompression (bunzip2) support"
    select DECOMP_COMMON
    help
      Enables bzip2 decompression (bunzip2) support of kernel images

config DECOMP_UNXZ
    bool "XZ decompression (unxz) support"
    select DECOMP_COMMON
    help
      Enables XZ decompression (unxz) support of kernel images

config DECOMP_UNLZMA
    bool "Lzma decompression (unlzma) support"
    select DECOMP_COMMON
    help
      Enables Lzma decompression (unlzma) support of kernel images

config DECOMP_UNLZO
    bool "LZO decompression (unlzo) support"
    select DECOMP_COMMON
    help
      Enables LZO decompression (unlzo) support of kernel images

config DECOMP_UNLZ4
    bool "LZ4 decompression (unlz4) support"
    select DECOMP_COMMON
    help
      Enables LZ4 decompression (unlz4) support of kernel images

config DECOMP_UNZSTD
    bool "ZSTD decompression (unzstd) support"
    select DECOMP_COMMON
    help
      Enables ZSTD decompression (unzstd) support of kernel images

config DECOMP_X86_ALL
    bool "Enable all X86 de-compressors"
    default y
    depends on X86
    select DECOMP_BUNZIP2
    select DECOMP_UNXZ
    select DECOMP_UNLZMA
    select DECOMP_UNLZO
    select DECOMP_UNLZ4
    select DECOMP_UNZSTD
    select DECOMP_UNGZIP

endmenu

config DECOMP_COMMON
    bool
```

## xen/common/virtio/Kconfig
```kconfig
menu "Virtio"
	visible if EXPERT

config VIRTIO_MSG_BUS_CORE
	bool

config NR_VIRTIO_MSG_BUSES
	int "Maximum number of virtio-msg-buses supported"
	range 1 128
	default "4"
	depends on VIRTIO_MSG_BUS_CORE
	help
	  Controls the build-time size of various arrays associated with
	  management of multiple buses. It is the upper bound of
	  the number of virtio-msg-bus devices that Xen can handle.

config VIRTIO_MSG_BUS_XEN
	bool "Virtio-msg-bus Xen"
	default n
	select VIRTIO_MSG_BUS_CORE
	depends on ARM || X86
	help
	  Virtio-msg bus implementation using FIFOs on top of shared memory
	  and event channels for notifications. This is suitable for
	  communicating using virtio-msg between Xen and guests.

config VIRTIO_MMIO_NON_BLOCKING
	bool "Non-blocking virtio-mmio"
	default n
	depends on VIRTIO_MSG_BUS_CORE && (ARM || (X86 && HVM)) && DEVICE_TREE_PARSE
	help
	  Non-blocking virtio-mmio is a modified version of virtio-mmio
	  partially implemented in Xen itself allowing VMs to do virtio
	  in a way that does not pause vcpus. This allows real-time sensitive
	  guests to for example handle interrupts or do other work while
	  virtio-mmio is processing a register access. Behind the scenes,
	  Xen translates virtio-mmio into virtio-msg and adds an indirect
	  register extension to virtio-mmio.

endmenu
```

## xen/drivers/Kconfig
```kconfig
menu "Device Drivers"

source "drivers/acpi/Kconfig"

source "drivers/char/Kconfig"

source "drivers/cpufreq/Kconfig"

source "drivers/passthrough/Kconfig"

source "drivers/pci/Kconfig"

source "drivers/video/Kconfig"

config VPCI
   bool "Virtual PCI device emulation" if EXPERT
   default HVM
   depends on HAS_VPCI
   help
     Enables virtual PCI device emulation, providing emulated PCI
     configuration space access. This is required for PCI passthrough
     to PVH and ARM guests.

     PCI support for the hardware domain (Dom0) does not require this.
     If unsure, say Y.

config HAS_VPCI
	bool
	select HAS_PCI

config HAS_VPCI_GUEST_SUPPORT
	bool
	select HAS_VPCI

endmenu
```

## xen/drivers/acpi/Kconfig
```kconfig
config ACPI
	bool

config ACPI_LEGACY_TABLES_LOOKUP
	bool

config APEI
   bool "ACPI Platform Error Interface (APEI) support" if EXPERT
   depends on X86
   default y
   help
     Support for the ACPI Platform Error Interface, including the
     Hardware Error Source Table (HEST) and Error Record Serialization
     Table (ERST). ERST is used to persist machine check records to
     NVRAM on fatal errors. HEST is used for PCIe AER firmware-first
     error handling.

     If unsure, say Y.

config ACPI_NUMA
	bool
	select NUMA
```

## xen/drivers/cpufreq/Kconfig
```kconfig
config HAS_CPUFREQ
	bool

config CPUFREQ
	bool "CPU Frequency scaling"
	default y
	depends on HAS_CPUFREQ
	help
	  Enable CPU frequency scaling and power management governors.
	  This allows Xen to dynamically adjust CPU P-states (performance
	  states) based on system load.

	  Disabling this option removes all cpufreq governors and power
	  management interfaces. This is useful for real-time systems or
	  minimal hypervisor builds.
```

## xen/drivers/gpu/Kconfig
```kconfig
config GPU
	bool

if ARM
menuconfig MALI_G78AE
	bool "Mali G78AE GPU support (EA)"	if EXPERT
	select GPU
	select MALI_GSI_SCHED_NULL
	default n
	help
	  Support for implementation of hardware virtualization available in the
	  Mali G78AE GPU.

if MALI_G78AE

config MALI_G78AE_VERSAL2
	bool "Mali G78AE GPU support for Versal2"
	default n
	help
	  Support for Mali G78AE GPU on Versal2 platform.

config MALI_G78AE_VERSAL_MMI_SLRC_REG_CFG_0
	hex "GPU_CORR_IRQ_CFG0 value in MMI_SLRC" if MALI_G78AE_VERSAL2
	default 0xDCBA9876
	help
	  Value for the GPU_CORR_IRQ_CFG0 register for Mali G78AE on Versal2 platform.
	  By default, this is set to 0xDCBA9876, which is the value used in the Versal2
	  on reset. This value set the first 8 IRQ lines to be used for AWs.

config MALI_G78AE_VERSAL_MMI_SLRC_REG_CFG_1
	hex "GPU_CORR_IRQ_CFG1 value in MMI_SLRC" if MALI_G78AE_VERSAL2
	default 0x00FE5432
	help
	  Value for the GPU_CORR_IRQ_CFG1 register for Mali G78AE on Versal2 platform.
	  By default, this is set to 0x00FE5432, which is the value used in the Versal2
	  on reset. This value set the next 2 IRQ lines to be used for RGs and system
	  blocks.

config MALI_GSI_SCHED_NULL
	bool "Null scheduler support"
	default y
	help
	  The null scheduler provides static GPU partitioning with no
	  time-slicing. Each VM gets exclusive, indefinite access to its
	  assigned GPU partition. Only one VM can use a partition at a time;
	  additional requests are rejected.

config MALI_GSI_SCHED_TIMESLICE
	bool "Timeslice scheduler support"
	default y
	help
	  The timeslice scheduler allows multiple VMs to share a GPU
	  partition by taking turns. Uses timer-driven preemption with
	  configurable time quantum (default 7ms). When a VM's quantum
	  expires, it receives GPU_STOP and the next VM in the queue
	  gets GPU_GRANTED.

choice
	prompt "Default GPU scheduler"
	default MALI_GSI_SCHED_TIMESLICE_DEFAULT if MALI_GSI_SCHED_TIMESLICE
	default MALI_GSI_SCHED_NULL_DEFAULT

config MALI_GSI_SCHED_NULL_DEFAULT
	bool "Null scheduler" if MALI_GSI_SCHED_NULL

config MALI_GSI_SCHED_TIMESLICE_DEFAULT
	bool "Timeslice scheduler" if MALI_GSI_SCHED_TIMESLICE

endchoice

config MALI_GSI_SCHED_DEFAULT
	string
	default "ts" if MALI_GSI_SCHED_TIMESLICE_DEFAULT
	default "null" if MALI_GSI_SCHED_NULL_DEFAULT
	default "null"

endif # MALI_G78AE

endif # ARM
```
