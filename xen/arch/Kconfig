## xen/arch/Kconfig
```kconfig
config 64BIT
	bool

config NR_CPUS
	int "Maximum number of CPUs"
	range 1 4095
	default "256" if X86
	default "8" if ARM && RCAR3
	default "4" if ARM && QEMU
	default "4" if ARM && MPSOC
	default "128" if ARM
	help
	  Controls the build-time size of various arrays and bitmaps
	  associated with multiple-cpu management.  It is the upper bound of
	  the number of logical entities the scheduler can run code on.

	  For CPU cores which support Simultaneous Multi-Threading or similar
	  technologies, this the number of logical threads which Xen will
	  support.

config LLC_COLORING
	bool "Last Level Cache (LLC) coloring" if EXPERT
	depends on HAS_LLC_COLORING

config NR_LLC_COLORS
	int "Maximum number of LLC colors"
	default 128
	depends on LLC_COLORING
	help
	  Controls the build-time size of various arrays associated with LLC
	  coloring. Refer to the documentation for how to compute the number
	  of colors supported by the platform.
	  The default value corresponds to an 8 MiB 16-ways LLC, which should be
	  more than what needed in the general case.
	  Note that if, at any time, a color configuration with more colors than
	  the maximum is employed, an error is produced.

config BUDDY_ALLOCATOR_SIZE
	int "Buddy allocator reserved memory size (MiB)"
	default "64"
	depends on LLC_COLORING
	help
	  Amount of memory reserved for the buddy allocator to work alongside
	  the colored one. The colored allocator is meant as an alternative to the
	  buddy allocator because its allocation policy is by definition
	  incompatible with the generic one. Since the Xen heap is not colored yet,
	  we need to support the coexistence of the two allocators and some memory
	  must be left for the buddy one.
```

## xen/arch/arm_mpu/platforms/Kconfig
```kconfig
choice
	prompt "Platform Support"
	default ALL_PLAT
	default FVP_BASER if ARM_V8R
	---help---
	Choose which hardware platform to enable in Xen.

	If unsure, choose ALL_PLAT.

config ALL_PLAT
	bool "All Platforms"
	depends on !ARM_V8R
	---help---
	Enable support for all available hardware platforms. It doesn't
	automatically select any of the related drivers.

config QEMU
	bool "QEMU aarch virt machine support"
	depends on ARM_64 && !ARM_V8R
	select GICV3
	select HAS_PL011
	---help---
	Enable all the required drivers for QEMU aarch64 virt emulated
	machine.

config RCAR3
	bool "Renesas RCar3 support"
	depends on ARM_64 && !ARM_V8R
	select HAS_SCIF
	select IPMMU_VMSA
	---help---
	Enable all the required drivers for Renesas RCar3

config MPSOC
	bool "Xilinx Ultrascale+ MPSoC support"
	depends on ARM_64 && !ARM_V8R
	select HAS_CADENCE_UART
	select ARM_SMMU
	---help---
	Enable all the required drivers for Xilinx Ultrascale+ MPSoC

config FVP_BASER
	bool "Fixed Virtual Platform BaseR support"
	depends on ARM_V8R || AARCH32_V8R
	help
	  Enable platform specific configurations for Fixed Virtual
	  Platform BaseR

config NO_PLAT
	bool "No Platforms"
	depends on !ARM_V8R
	---help---
	Do not enable specific support for any platform.

endchoice

config ALL64_PLAT
	bool
	default (ALL_PLAT && ARM_64)

config ALL32_PLAT
	bool
	default (ALL_PLAT && ARM_32 && !AARCH32_V8R)

config MPSOC_PLATFORM
	bool
	default (ALL64_PLAT || MPSOC)
```

## xen/drivers/pci/Kconfig
```kconfig
config HAS_PCI
	bool

config HAS_PCI_MSI
	bool
	depends on HAS_PCI

config PCI_PASSTHROUGH
	bool "PCI Passthrough on ARM (UNSUPPORTED)" if UNSUPPORTED
	depends on ARM_64
	select HAS_PCI
	select HAS_VPCI
	select LATE_HWDOM
	select ARM_SMMU_V3
	select HAS_VPCI_GUEST_SUPPORT
	select HAS_HAS_ITS
	default n
	---help---

	PCI device Passthrough on ARM (Early Access)
```
